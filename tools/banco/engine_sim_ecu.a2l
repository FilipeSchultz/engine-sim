ASAP2_VERSION 1 71
/begin PROJECT engine_sim_ecu ""
/begin HEADER "" VERSION "1.0" PROJECT_NO XCPLITE__ACSDD /end HEADER
/begin MODULE engine_sim_ecu ""
/include "XCP_104.aml"
/begin MOD_COMMON "" BYTE_ORDER MSB_LAST ALIGNMENT_BYTE 1 ALIGNMENT_WORD 1 ALIGNMENT_LONG 1 ALIGNMENT_FLOAT16_IEEE 1 ALIGNMENT_FLOAT32_IEEE 1 ALIGNMENT_FLOAT64_IEEE 1 ALIGNMENT_INT64 1 /end MOD_COMMON
/begin COMPU_METHOD conv.bool "" TAB_VERB "%.0" "" COMPU_TAB_REF conv.bool.table /end COMPU_METHOD
/begin COMPU_VTAB conv.bool.table "" TAB_VERB 2 0 "false" 1 "true" /end COMPU_VTAB
/begin RECORD_LAYOUT U8 FNC_VALUES 1 UBYTE ROW_DIR DIRECT /end RECORD_LAYOUT
/begin RECORD_LAYOUT A_U8 AXIS_PTS_X 1 UBYTE INDEX_INCR DIRECT /end RECORD_LAYOUT
/begin TYPEDEF_MEASUREMENT M_U8 "" UBYTE NO_COMPU_METHOD 0 0 0 255 /end TYPEDEF_MEASUREMENT
/begin TYPEDEF_CHARACTERISTIC C_U8 "" VALUE U8 0 NO_COMPU_METHOD 0 255 /end TYPEDEF_CHARACTERISTIC
/begin RECORD_LAYOUT U16 FNC_VALUES 1 UWORD ROW_DIR DIRECT /end RECORD_LAYOUT
/begin RECORD_LAYOUT A_U16 AXIS_PTS_X 1 UWORD INDEX_INCR DIRECT /end RECORD_LAYOUT
/begin TYPEDEF_MEASUREMENT M_U16 "" UWORD NO_COMPU_METHOD 0 0 0 65535 /end TYPEDEF_MEASUREMENT
/begin TYPEDEF_CHARACTERISTIC C_U16 "" VALUE U16 0 NO_COMPU_METHOD 0 65535 /end TYPEDEF_CHARACTERISTIC
/begin RECORD_LAYOUT U32 FNC_VALUES 1 ULONG ROW_DIR DIRECT /end RECORD_LAYOUT
/begin RECORD_LAYOUT A_U32 AXIS_PTS_X 1 ULONG INDEX_INCR DIRECT /end RECORD_LAYOUT
/begin TYPEDEF_MEASUREMENT M_U32 "" ULONG NO_COMPU_METHOD 0 0 0 4294967295 /end TYPEDEF_MEASUREMENT
/begin TYPEDEF_CHARACTERISTIC C_U32 "" VALUE U32 0 NO_COMPU_METHOD 0 4.29497e+09 /end TYPEDEF_CHARACTERISTIC
/begin RECORD_LAYOUT U64 FNC_VALUES 1 A_UINT64 ROW_DIR DIRECT /end RECORD_LAYOUT
/begin RECORD_LAYOUT A_U64 AXIS_PTS_X 1 A_UINT64 INDEX_INCR DIRECT /end RECORD_LAYOUT
/begin TYPEDEF_MEASUREMENT M_U64 "" A_UINT64 NO_COMPU_METHOD 0 0 0 1000000000000 /end TYPEDEF_MEASUREMENT
/begin TYPEDEF_CHARACTERISTIC C_U64 "" VALUE U64 0 NO_COMPU_METHOD 0 1e+12 /end TYPEDEF_CHARACTERISTIC
/begin RECORD_LAYOUT I8 FNC_VALUES 1 SBYTE ROW_DIR DIRECT /end RECORD_LAYOUT
/begin RECORD_LAYOUT A_I8 AXIS_PTS_X 1 SBYTE INDEX_INCR DIRECT /end RECORD_LAYOUT
/begin TYPEDEF_MEASUREMENT M_I8 "" SBYTE NO_COMPU_METHOD 0 0 -128 127 /end TYPEDEF_MEASUREMENT
/begin TYPEDEF_CHARACTERISTIC C_I8 "" VALUE I8 0 NO_COMPU_METHOD -128 127 /end TYPEDEF_CHARACTERISTIC
/begin RECORD_LAYOUT I16 FNC_VALUES 1 SWORD ROW_DIR DIRECT /end RECORD_LAYOUT
/begin RECORD_LAYOUT A_I16 AXIS_PTS_X 1 SWORD INDEX_INCR DIRECT /end RECORD_LAYOUT
/begin TYPEDEF_MEASUREMENT M_I16 "" SWORD NO_COMPU_METHOD 0 0 -32768 32767 /end TYPEDEF_MEASUREMENT
/begin TYPEDEF_CHARACTERISTIC C_I16 "" VALUE I16 0 NO_COMPU_METHOD -32768 32767 /end TYPEDEF_CHARACTERISTIC
/begin RECORD_LAYOUT I32 FNC_VALUES 1 SLONG ROW_DIR DIRECT /end RECORD_LAYOUT
/begin RECORD_LAYOUT A_I32 AXIS_PTS_X 1 SLONG INDEX_INCR DIRECT /end RECORD_LAYOUT
/begin TYPEDEF_MEASUREMENT M_I32 "" SLONG NO_COMPU_METHOD 0 0 -2147483648 2147483647 /end TYPEDEF_MEASUREMENT
/begin TYPEDEF_CHARACTERISTIC C_I32 "" VALUE I32 0 NO_COMPU_METHOD -2.14748e+09 2.14748e+09 /end TYPEDEF_CHARACTERISTIC
/begin RECORD_LAYOUT I64 FNC_VALUES 1 A_INT64 ROW_DIR DIRECT /end RECORD_LAYOUT
/begin RECORD_LAYOUT A_I64 AXIS_PTS_X 1 A_INT64 INDEX_INCR DIRECT /end RECORD_LAYOUT
/begin TYPEDEF_MEASUREMENT M_I64 "" A_INT64 NO_COMPU_METHOD 0 0 -1000000000000 1000000000000 /end TYPEDEF_MEASUREMENT
/begin TYPEDEF_CHARACTERISTIC C_I64 "" VALUE I64 0 NO_COMPU_METHOD -1e+12 1e+12 /end TYPEDEF_CHARACTERISTIC
/begin RECORD_LAYOUT F32 FNC_VALUES 1 FLOAT32_IEEE ROW_DIR DIRECT /end RECORD_LAYOUT
/begin RECORD_LAYOUT A_F32 AXIS_PTS_X 1 FLOAT32_IEEE INDEX_INCR DIRECT /end RECORD_LAYOUT
/begin TYPEDEF_MEASUREMENT M_F32 "" FLOAT32_IEEE NO_COMPU_METHOD 0 0 -1e+12 1e+12 /end TYPEDEF_MEASUREMENT
/begin TYPEDEF_CHARACTERISTIC C_F32 "" VALUE F32 0 NO_COMPU_METHOD -1e+12 1e+12 /end TYPEDEF_CHARACTERISTIC
/begin RECORD_LAYOUT F64 FNC_VALUES 1 FLOAT64_IEEE ROW_DIR DIRECT /end RECORD_LAYOUT
/begin RECORD_LAYOUT A_F64 AXIS_PTS_X 1 FLOAT64_IEEE INDEX_INCR DIRECT /end RECORD_LAYOUT
/begin TYPEDEF_MEASUREMENT M_F64 "" FLOAT64_IEEE NO_COMPU_METHOD 0 0 -1e+12 1e+12 /end TYPEDEF_MEASUREMENT
/begin TYPEDEF_CHARACTERISTIC C_F64 "" VALUE F64 0 NO_COMPU_METHOD -1e+12 1e+12 /end TYPEDEF_CHARACTERISTIC
/begin CHARACTERISTIC CrankingRpm "Engine speed below which the engine is considered cranking" VALUE 0x542F0 F32 0 NO_COMPU_METHOD 0 2000 PHYS_UNIT "rpm" /end CHARACTERISTIC
/begin CHARACTERISTIC RevLimitRpm "Fuel cut above this engine speed (0 = off)" VALUE 0x542F4 F32 0 NO_COMPU_METHOD 0 20000 PHYS_UNIT "rpm" /end CHARACTERISTIC
/begin CHARACTERISTIC RevLimitHysteresis "Fuel comes back below RevLimitRpm minus this" VALUE 0x542F8 F32 0 NO_COMPU_METHOD 0 2000 PHYS_UNIT "rpm" /end CHARACTERISTIC
/begin CHARACTERISTIC LambdaCtrlEnable "Closed loop lambda control (0 = off)" VALUE 0x542FC F32 0 NO_COMPU_METHOD 0 1 PHYS_UNIT "-" /end CHARACTERISTIC
/begin CHARACTERISTIC LambdaTarget "Lambda set point" VALUE 0x54300 F32 0 NO_COMPU_METHOD 0.5 2 PHYS_UNIT "-" /end CHARACTERISTIC
/begin CHARACTERISTIC LambdaCtrlKp "Proportional gain: fuel correction per unit of lambda error" VALUE 0x54304 F32 0 NO_COMPU_METHOD 0 10 PHYS_UNIT "-" /end CHARACTERISTIC
/begin CHARACTERISTIC LambdaCtrlKi "Integral gain: fuel correction per unit of lambda error and second" VALUE 0x54308 F32 0 NO_COMPU_METHOD 0 20 PHYS_UNIT "1/s" /end CHARACTERISTIC
/begin CHARACTERISTIC LambdaCtrlLimit "Maximum fuel correction of the controller (fraction)" VALUE 0x5430C F32 0 NO_COMPU_METHOD 0 0.5 PHYS_UNIT "-" /end CHARACTERISTIC
/begin CHARACTERISTIC LambdaCtrlStartDelay "Time after start before the controller is enabled" VALUE 0x54310 F32 0 NO_COMPU_METHOD 0 120 PHYS_UNIT "s" /end CHARACTERISTIC
/begin CHARACTERISTIC EcuFuelEnable "Fuel from FuelBaseMap (0 = engine script mixture)" VALUE 0x54314 F32 0 NO_COMPU_METHOD 0 1 PHYS_UNIT "-" /end CHARACTERISTIC
/begin CHARACTERISTIC InjectorFlow "Injector static flow" VALUE 0x54318 F32 0 NO_COMPU_METHOD 1 20000 PHYS_UNIT "cc/min" /end CHARACTERISTIC
/begin CHARACTERISTIC InjectorDeadTime "Injector dead time" VALUE 0x5431C F32 0 NO_COMPU_METHOD 0 10 PHYS_UNIT "ms" /end CHARACTERISTIC
/begin AXIS_PTS FuelBaseMap_X "X axis of FuelBaseMap" 0x54320 rpm A_F32 0 NO_COMPU_METHOD 16 0 20000 PHYS_UNIT "rpm" /end AXIS_PTS
/begin AXIS_PTS FuelBaseMap_Y "Y axis of FuelBaseMap" 0x54360 map_kPa A_F32 0 NO_COMPU_METHOD 12 0 400 PHYS_UNIT "kPa" /end AXIS_PTS
/begin CHARACTERISTIC FuelBaseMap "Base injection time (dead time included)" MAP 0x54390 F32 0 NO_COMPU_METHOD 0 100
 /begin AXIS_DESCR COM_AXIS rpm NO_COMPU_METHOD 16 0.0 0.0 AXIS_PTS_REF FuelBaseMap_X /end AXIS_DESCR
 /begin AXIS_DESCR COM_AXIS map_kPa NO_COMPU_METHOD 12 0.0 0.0 AXIS_PTS_REF FuelBaseMap_Y /end AXIS_DESCR
 PHYS_UNIT "ms" /end CHARACTERISTIC
/begin CHARACTERISTIC CrankingFuelFactor "Injection time multiplier while cranking (0 = start on the script mixture)" VALUE 0x54690 F32 0 NO_COMPU_METHOD 0 5 PHYS_UNIT "-" /end CHARACTERISTIC
/begin CHARACTERISTIC AfterStartTime "Time for the cranking factor to fade to 1 once the engine runs" VALUE 0x54694 F32 0 NO_COMPU_METHOD 0 60 PHYS_UNIT "s" /end CHARACTERISTIC
/begin AXIS_PTS FuelCltCorr_X "X axis of FuelCltCorr" 0x54698 clt_C A_F32 0 NO_COMPU_METHOD 8 -50 200 PHYS_UNIT "degC" /end AXIS_PTS
/begin CHARACTERISTIC FuelCltCorr "Warm-up fuel factor vs coolant temperature" CURVE 0x546B8 F32 0 NO_COMPU_METHOD 0 5
 /begin AXIS_DESCR COM_AXIS clt_C NO_COMPU_METHOD 8 0.0 0.0 AXIS_PTS_REF FuelCltCorr_X /end AXIS_DESCR
 PHYS_UNIT "-" /end CHARACTERISTIC
/begin AXIS_PTS FuelIatCorr_X "X axis of FuelIatCorr" 0x546D8 iat_C A_F32 0 NO_COMPU_METHOD 6 -50 200 PHYS_UNIT "degC" /end AXIS_PTS
/begin CHARACTERISTIC FuelIatCorr "Fuel factor vs intake air temperature" CURVE 0x546F0 F32 0 NO_COMPU_METHOD 0 5
 /begin AXIS_DESCR COM_AXIS iat_C NO_COMPU_METHOD 6 0.0 0.0 AXIS_PTS_REF FuelIatCorr_X /end AXIS_DESCR
 PHYS_UNIT "-" /end CHARACTERISTIC
/begin CHARACTERISTIC EcuIgnEnable "Spark advance from IgnAdvanceMap (0 = engine script curve)" VALUE 0x54708 F32 0 NO_COMPU_METHOD 0 1 PHYS_UNIT "-" /end CHARACTERISTIC
/begin AXIS_PTS IgnAdvanceMap_X "X axis of IgnAdvanceMap" 0x5470C rpm A_F32 0 NO_COMPU_METHOD 16 0 20000 PHYS_UNIT "rpm" /end AXIS_PTS
/begin AXIS_PTS IgnAdvanceMap_Y "Y axis of IgnAdvanceMap" 0x5474C map_kPa A_F32 0 NO_COMPU_METHOD 12 0 400 PHYS_UNIT "kPa" /end AXIS_PTS
/begin CHARACTERISTIC IgnAdvanceMap "Base spark advance" MAP 0x5477C F32 0 NO_COMPU_METHOD -30 70
 /begin AXIS_DESCR COM_AXIS rpm NO_COMPU_METHOD 16 0.0 0.0 AXIS_PTS_REF IgnAdvanceMap_X /end AXIS_DESCR
 /begin AXIS_DESCR COM_AXIS map_kPa NO_COMPU_METHOD 12 0.0 0.0 AXIS_PTS_REF IgnAdvanceMap_Y /end AXIS_DESCR
 PHYS_UNIT "deg" /end CHARACTERISTIC
/begin AXIS_PTS IgnCltCorr_X "X axis of IgnCltCorr" 0x54A7C clt_C A_F32 0 NO_COMPU_METHOD 8 -50 200 PHYS_UNIT "degC" /end AXIS_PTS
/begin CHARACTERISTIC IgnCltCorr "Spark advance added vs coolant temperature" CURVE 0x54A9C F32 0 NO_COMPU_METHOD -30 30
 /begin AXIS_DESCR COM_AXIS clt_C NO_COMPU_METHOD 8 0.0 0.0 AXIS_PTS_REF IgnCltCorr_X /end AXIS_DESCR
 PHYS_UNIT "deg" /end CHARACTERISTIC
/begin AXIS_PTS IgnIatCorr_X "X axis of IgnIatCorr" 0x54ABC iat_C A_F32 0 NO_COMPU_METHOD 6 -50 200 PHYS_UNIT "degC" /end AXIS_PTS
/begin CHARACTERISTIC IgnIatCorr "Spark advance added vs intake air temperature" CURVE 0x54AD4 F32 0 NO_COMPU_METHOD -30 30
 /begin AXIS_DESCR COM_AXIS iat_C NO_COMPU_METHOD 6 0.0 0.0 AXIS_PTS_REF IgnIatCorr_X /end AXIS_DESCR
 PHYS_UNIT "deg" /end CHARACTERISTIC
/begin CHARACTERISTIC CalSaveRequest "Set from 0 to 1 to save the calibration to the DCM file (set back to 0 for the next save)" VALUE 0x54AEC F32 0 NO_COMPU_METHOD 0 1 PHYS_UNIT "-" /end CHARACTERISTIC
/begin CHARACTERISTIC InjectionAngle "Start of injection, degrees before the cylinder's firing TDC (port injection: the fuel waits in the port until the intake valve opens)" VALUE 0x54AF0 F32 0 NO_COMPU_METHOD 0 720 PHYS_UNIT "deg" /end CHARACTERISTIC
/begin MEASUREMENT rpm "Engine speed, averaged over the last firing interval" FLOAT64_IEEE NO_COMPU_METHOD 0 0 -1e+06 1e+06 ECU_ADDRESS 0x53598 PHYS_UNIT "rpm" READ_WRITE
 /begin IF_DATA XCP
  /begin DAQ_EVENT VARIABLE /begin DEFAULT_EVENT_LIST EVENT 0x0 /end DEFAULT_EVENT_LIST /end DAQ_EVENT
 /end IF_DATA
/end MEASUREMENT
/begin MEASUREMENT map_kPa "Manifold pressure, averaged over the last firing interval" FLOAT64_IEEE NO_COMPU_METHOD 0 0 -1e+06 1e+06 ECU_ADDRESS 0x535A0 PHYS_UNIT "kPa" READ_WRITE
 /begin IF_DATA XCP
  /begin DAQ_EVENT VARIABLE /begin DEFAULT_EVENT_LIST EVENT 0x0 /end DEFAULT_EVENT_LIST /end DAQ_EVENT
 /end IF_DATA
/end MEASUREMENT
/begin MEASUREMENT rpm_instant "Engine speed, instantaneous" FLOAT64_IEEE NO_COMPU_METHOD 0 0 -1e+06 1e+06 ECU_ADDRESS 0x53588 PHYS_UNIT "rpm" READ_WRITE
 /begin IF_DATA XCP
  /begin DAQ_EVENT VARIABLE /begin DEFAULT_EVENT_LIST EVENT 0x0 /end DEFAULT_EVENT_LIST /end DAQ_EVENT
 /end IF_DATA
/end MEASUREMENT
/begin MEASUREMENT map_instant_kPa "Manifold pressure, instantaneous" FLOAT64_IEEE NO_COMPU_METHOD 0 0 -1e+06 1e+06 ECU_ADDRESS 0x53590 PHYS_UNIT "kPa" READ_WRITE
 /begin IF_DATA XCP
  /begin DAQ_EVENT VARIABLE /begin DEFAULT_EVENT_LIST EVENT 0x0 /end DEFAULT_EVENT_LIST /end DAQ_EVENT
 /end IF_DATA
/end MEASUREMENT
/begin MEASUREMENT iat_C "Intake air temperature" FLOAT64_IEEE NO_COMPU_METHOD 0 0 -1e+06 1e+06 ECU_ADDRESS 0x535A8 PHYS_UNIT "degC" READ_WRITE
 /begin IF_DATA XCP
  /begin DAQ_EVENT VARIABLE /begin DEFAULT_EVENT_LIST EVENT 0x0 /end DEFAULT_EVENT_LIST /end DAQ_EVENT
 /end IF_DATA
/end MEASUREMENT
/begin MEASUREMENT clt_C "Coolant temperature" FLOAT64_IEEE NO_COMPU_METHOD 0 0 -1e+06 1e+06 ECU_ADDRESS 0x535B0 PHYS_UNIT "degC" READ_WRITE
 /begin IF_DATA XCP
  /begin DAQ_EVENT VARIABLE /begin DEFAULT_EVENT_LIST EVENT 0x0 /end DEFAULT_EVENT_LIST /end DAQ_EVENT
 /end IF_DATA
/end MEASUREMENT
/begin MEASUREMENT tps_percent "Throttle position" FLOAT64_IEEE NO_COMPU_METHOD 0 0 -1e+06 1e+06 ECU_ADDRESS 0x535B8 PHYS_UNIT "%" READ_WRITE
 /begin IF_DATA XCP
  /begin DAQ_EVENT VARIABLE /begin DEFAULT_EVENT_LIST EVENT 0x0 /end DEFAULT_EVENT_LIST /end DAQ_EVENT
 /end IF_DATA
/end MEASUREMENT
/begin MEASUREMENT lambda_sensor "Wideband lambda sensor (0 = not ready)" FLOAT64_IEEE NO_COMPU_METHOD 0 0 -1e+06 1e+06 ECU_ADDRESS 0x535C0 PHYS_UNIT "-" READ_WRITE
 /begin IF_DATA XCP
  /begin DAQ_EVENT VARIABLE /begin DEFAULT_EVENT_LIST EVENT 0x0 /end DEFAULT_EVENT_LIST /end DAQ_EVENT
 /end IF_DATA
/end MEASUREMENT
/begin MEASUREMENT engine_state "0 = stopped, 1 = cranking, 2 = running" FLOAT64_IEEE NO_COMPU_METHOD 0 0 -1e+06 1e+06 ECU_ADDRESS 0x535D0 PHYS_UNIT "-" READ_WRITE
 /begin IF_DATA XCP
  /begin DAQ_EVENT VARIABLE /begin DEFAULT_EVENT_LIST EVENT 0x0 /end DEFAULT_EVENT_LIST /end DAQ_EVENT
 /end IF_DATA
/end MEASUREMENT
/begin MEASUREMENT running_time_s "Time since the engine left cranking" FLOAT64_IEEE NO_COMPU_METHOD 0 0 -1e+06 1e+06 ECU_ADDRESS 0x535D8 PHYS_UNIT "s" READ_WRITE
 /begin IF_DATA XCP
  /begin DAQ_EVENT VARIABLE /begin DEFAULT_EVENT_LIST EVENT 0x0 /end DEFAULT_EVENT_LIST /end DAQ_EVENT
 /end IF_DATA
/end MEASUREMENT
/begin MEASUREMENT fuel_cut "1 = rev limiter cutting fuel" FLOAT64_IEEE NO_COMPU_METHOD 0 0 -1e+06 1e+06 ECU_ADDRESS 0x535E0 PHYS_UNIT "-" READ_WRITE
 /begin IF_DATA XCP
  /begin DAQ_EVENT VARIABLE /begin DEFAULT_EVENT_LIST EVENT 0x0 /end DEFAULT_EVENT_LIST /end DAQ_EVENT
 /end IF_DATA
/end MEASUREMENT
/begin MEASUREMENT lambda_target "Lambda set point" FLOAT64_IEEE NO_COMPU_METHOD 0 0 -1e+06 1e+06 ECU_ADDRESS 0x535E8 PHYS_UNIT "-" READ_WRITE
 /begin IF_DATA XCP
  /begin DAQ_EVENT VARIABLE /begin DEFAULT_EVENT_LIST EVENT 0x0 /end DEFAULT_EVENT_LIST /end DAQ_EVENT
 /end IF_DATA
/end MEASUREMENT
/begin MEASUREMENT lambda_ctrl_active "1 = closed loop lambda active" FLOAT64_IEEE NO_COMPU_METHOD 0 0 -1e+06 1e+06 ECU_ADDRESS 0x535F0 PHYS_UNIT "-" READ_WRITE
 /begin IF_DATA XCP
  /begin DAQ_EVENT VARIABLE /begin DEFAULT_EVENT_LIST EVENT 0x0 /end DEFAULT_EVENT_LIST /end DAQ_EVENT
 /end IF_DATA
/end MEASUREMENT
/begin MEASUREMENT fuel_corr_lambda "Fuel correction of the lambda controller" FLOAT64_IEEE NO_COMPU_METHOD 0 0 -1e+06 1e+06 ECU_ADDRESS 0x535F8 PHYS_UNIT "-" READ_WRITE
 /begin IF_DATA XCP
  /begin DAQ_EVENT VARIABLE /begin DEFAULT_EVENT_LIST EVENT 0x0 /end DEFAULT_EVENT_LIST /end DAQ_EVENT
 /end IF_DATA
/end MEASUREMENT
/begin MEASUREMENT fuel_ecu "1 = injection controlled by the ECU" FLOAT64_IEEE NO_COMPU_METHOD 0 0 -1e+06 1e+06 ECU_ADDRESS 0x53600 PHYS_UNIT "-" READ_WRITE
 /begin IF_DATA XCP
  /begin DAQ_EVENT VARIABLE /begin DEFAULT_EVENT_LIST EVENT 0x0 /end DEFAULT_EVENT_LIST /end DAQ_EVENT
 /end IF_DATA
/end MEASUREMENT
/begin MEASUREMENT injection_ms "Final injection time (dead time included)" FLOAT64_IEEE NO_COMPU_METHOD 0 0 -1e+06 1e+06 ECU_ADDRESS 0x53628 PHYS_UNIT "ms" READ_WRITE
 /begin IF_DATA XCP
  /begin DAQ_EVENT VARIABLE /begin DEFAULT_EVENT_LIST EVENT 0x0 /end DEFAULT_EVENT_LIST /end DAQ_EVENT
 /end IF_DATA
/end MEASUREMENT
/begin MEASUREMENT injection_base_ms "FuelBaseMap value" FLOAT64_IEEE NO_COMPU_METHOD 0 0 -1e+06 1e+06 ECU_ADDRESS 0x53608 PHYS_UNIT "ms" READ_WRITE
 /begin IF_DATA XCP
  /begin DAQ_EVENT VARIABLE /begin DEFAULT_EVENT_LIST EVENT 0x0 /end DEFAULT_EVENT_LIST /end DAQ_EVENT
 /end IF_DATA
/end MEASUREMENT
/begin MEASUREMENT fuel_corr_start "Cranking / after-start factor" FLOAT64_IEEE NO_COMPU_METHOD 0 0 -1e+06 1e+06 ECU_ADDRESS 0x53610 PHYS_UNIT "-" READ_WRITE
 /begin IF_DATA XCP
  /begin DAQ_EVENT VARIABLE /begin DEFAULT_EVENT_LIST EVENT 0x0 /end DEFAULT_EVENT_LIST /end DAQ_EVENT
 /end IF_DATA
/end MEASUREMENT
/begin MEASUREMENT fuel_corr_clt "Coolant temperature factor" FLOAT64_IEEE NO_COMPU_METHOD 0 0 -1e+06 1e+06 ECU_ADDRESS 0x53618 PHYS_UNIT "-" READ_WRITE
 /begin IF_DATA XCP
  /begin DAQ_EVENT VARIABLE /begin DEFAULT_EVENT_LIST EVENT 0x0 /end DEFAULT_EVENT_LIST /end DAQ_EVENT
 /end IF_DATA
/end MEASUREMENT
/begin MEASUREMENT fuel_corr_iat "Intake air temperature factor" FLOAT64_IEEE NO_COMPU_METHOD 0 0 -1e+06 1e+06 ECU_ADDRESS 0x53620 PHYS_UNIT "-" READ_WRITE
 /begin IF_DATA XCP
  /begin DAQ_EVENT VARIABLE /begin DEFAULT_EVENT_LIST EVENT 0x0 /end DEFAULT_EVENT_LIST /end DAQ_EVENT
 /end IF_DATA
/end MEASUREMENT
/begin MEASUREMENT ignition_ecu "1 = spark advance controlled by the ECU" FLOAT64_IEEE NO_COMPU_METHOD 0 0 -1e+06 1e+06 ECU_ADDRESS 0x53638 PHYS_UNIT "-" READ_WRITE
 /begin IF_DATA XCP
  /begin DAQ_EVENT VARIABLE /begin DEFAULT_EVENT_LIST EVENT 0x0 /end DEFAULT_EVENT_LIST /end DAQ_EVENT
 /end IF_DATA
/end MEASUREMENT
/begin MEASUREMENT advance_deg "Final spark advance (before TDC)" FLOAT64_IEEE NO_COMPU_METHOD 0 0 -1e+06 1e+06 ECU_ADDRESS 0x53658 PHYS_UNIT "deg" READ_WRITE
 /begin IF_DATA XCP
  /begin DAQ_EVENT VARIABLE /begin DEFAULT_EVENT_LIST EVENT 0x0 /end DEFAULT_EVENT_LIST /end DAQ_EVENT
 /end IF_DATA
/end MEASUREMENT
/begin MEASUREMENT advance_base_deg "IgnAdvanceMap value" FLOAT64_IEEE NO_COMPU_METHOD 0 0 -1e+06 1e+06 ECU_ADDRESS 0x53640 PHYS_UNIT "deg" READ_WRITE
 /begin IF_DATA XCP
  /begin DAQ_EVENT VARIABLE /begin DEFAULT_EVENT_LIST EVENT 0x0 /end DEFAULT_EVENT_LIST /end DAQ_EVENT
 /end IF_DATA
/end MEASUREMENT
/begin MEASUREMENT advance_corr_clt_deg "Coolant temperature correction" FLOAT64_IEEE NO_COMPU_METHOD 0 0 -1e+06 1e+06 ECU_ADDRESS 0x53648 PHYS_UNIT "deg" READ_WRITE
 /begin IF_DATA XCP
  /begin DAQ_EVENT VARIABLE /begin DEFAULT_EVENT_LIST EVENT 0x0 /end DEFAULT_EVENT_LIST /end DAQ_EVENT
 /end IF_DATA
/end MEASUREMENT
/begin MEASUREMENT advance_corr_iat_deg "Intake air temperature correction" FLOAT64_IEEE NO_COMPU_METHOD 0 0 -1e+06 1e+06 ECU_ADDRESS 0x53650 PHYS_UNIT "deg" READ_WRITE
 /begin IF_DATA XCP
  /begin DAQ_EVENT VARIABLE /begin DEFAULT_EVENT_LIST EVENT 0x0 /end DEFAULT_EVENT_LIST /end DAQ_EVENT
 /end IF_DATA
/end MEASUREMENT
/begin MEASUREMENT cal_save_count "Calibration saves requested" FLOAT64_IEEE NO_COMPU_METHOD 0 0 -1e+06 1e+06 ECU_ADDRESS 0x53570 PHYS_UNIT "-" READ_WRITE
 /begin IF_DATA XCP
  /begin DAQ_EVENT VARIABLE /begin DEFAULT_EVENT_LIST EVENT 0x0 /end DEFAULT_EVENT_LIST /end DAQ_EVENT
 /end IF_DATA
/end MEASUREMENT
/* Typedefs */
/* Groups */
/begin GROUP Cal_Calibration "" ROOT /begin REF_CHARACTERISTIC CalSaveRequest /end REF_CHARACTERISTIC /end GROUP
/begin GROUP Cal_EngineState "" ROOT /begin REF_CHARACTERISTIC CrankingRpm /end REF_CHARACTERISTIC /end GROUP
/begin GROUP Cal_FuelControl "" ROOT
 /begin REF_CHARACTERISTIC EcuFuelEnable InjectorFlow InjectorDeadTime FuelBaseMap_X FuelBaseMap_Y FuelBaseMap CrankingFuelFactor AfterStartTime FuelCltCorr_X FuelCltCorr FuelIatCorr_X FuelIatCorr /end REF_CHARACTERISTIC
/end GROUP
/begin GROUP Cal_IgnitionControl "" ROOT
 /begin REF_CHARACTERISTIC EcuIgnEnable IgnAdvanceMap_X IgnAdvanceMap_Y IgnAdvanceMap IgnCltCorr_X IgnCltCorr IgnIatCorr_X IgnIatCorr /end REF_CHARACTERISTIC
/end GROUP
/begin GROUP Cal_LambdaControl "" ROOT
 /begin REF_CHARACTERISTIC LambdaCtrlEnable LambdaTarget LambdaCtrlKp LambdaCtrlKi LambdaCtrlLimit LambdaCtrlStartDelay /end REF_CHARACTERISTIC
/end GROUP
/begin GROUP Cal_OutputStage "" ROOT /begin REF_CHARACTERISTIC InjectionAngle /end REF_CHARACTERISTIC /end GROUP
/begin GROUP Cal_RevLimiter "" ROOT /begin REF_CHARACTERISTIC RevLimitRpm RevLimitHysteresis /end REF_CHARACTERISTIC /end GROUP
/begin GROUP Meas_Calibration "" ROOT /begin REF_MEASUREMENT cal_save_count /end REF_MEASUREMENT /end GROUP
/begin GROUP Meas_EngineState "" ROOT /begin REF_MEASUREMENT engine_state running_time_s /end REF_MEASUREMENT /end GROUP
/begin GROUP Meas_FuelControl "" ROOT
 /begin REF_MEASUREMENT fuel_ecu injection_ms injection_base_ms fuel_corr_start fuel_corr_clt fuel_corr_iat /end REF_MEASUREMENT
/end GROUP
/begin GROUP Meas_IgnitionControl "" ROOT
 /begin REF_MEASUREMENT ignition_ecu advance_deg advance_base_deg advance_corr_clt_deg advance_corr_iat_deg /end REF_MEASUREMENT
/end GROUP
/begin GROUP Meas_InputProcessing "" ROOT
 /begin REF_MEASUREMENT rpm map_kPa rpm_instant map_instant_kPa iat_C clt_C tps_percent lambda_sensor /end REF_MEASUREMENT
/end GROUP
/begin GROUP Meas_LambdaControl "" ROOT /begin REF_MEASUREMENT lambda_target lambda_ctrl_active fuel_corr_lambda /end REF_MEASUREMENT /end GROUP
/begin GROUP Meas_RevLimiter "" ROOT /begin REF_MEASUREMENT fuel_cut /end REF_MEASUREMENT /end GROUP
/* Conversions */
/begin MOD_PAR "" EPK "ESIM_ECU_947530E6" ADDR_EPK 0xFFFFFF00
 /begin MEMORY_SEGMENT epk "" DATA FLASH INTERN 0x0008C7F8 32 -1 -1 -1 -1 -1
  /begin IF_DATA XCP
   /begin SEGMENT 0 /* number */ 2 /* pages */ 0 /*addr_ext*/ 0 0 /begin CHECKSUM XCP_CRC_16_CITT MAX_BLOCK_SIZE 0xFFFF EXTERNAL_FUNCTION "" /end CHECKSUM
    /begin PAGE 0 ECU_ACCESS_DONT_CARE XCP_READ_ACCESS_DONT_CARE XCP_WRITE_ACCESS_DONT_CARE /end PAGE
    /begin PAGE 1 ECU_ACCESS_DONT_CARE XCP_READ_ACCESS_DONT_CARE XCP_WRITE_ACCESS_NOT_ALLOWED /end PAGE
   /end SEGMENT
  /end IF_DATA
 /end MEMORY_SEGMENT
 /begin MEMORY_SEGMENT EcuCalibration "" DATA FLASH INTERN 0x000542F0 2052 -1 -1 -1 -1 -1
  /begin IF_DATA XCP
   /begin SEGMENT 1 /* number */ 2 /* pages */ 0 /*addr_ext*/ 0 0 /begin CHECKSUM XCP_CRC_16_CITT MAX_BLOCK_SIZE 0xFFFF EXTERNAL_FUNCTION "" /end CHECKSUM
    /begin PAGE 0 ECU_ACCESS_DONT_CARE XCP_READ_ACCESS_DONT_CARE XCP_WRITE_ACCESS_DONT_CARE /end PAGE
    /begin PAGE 1 ECU_ACCESS_DONT_CARE XCP_READ_ACCESS_DONT_CARE XCP_WRITE_ACCESS_NOT_ALLOWED /end PAGE
   /end SEGMENT
  /end IF_DATA
 /end MEMORY_SEGMENT
/end MOD_PAR
/begin IF_DATA XCP
 /begin PROTOCOL_LAYER 0x104 1000 2000 0 0 0 0 0 248 1024 BYTE_ORDER_MSB_LAST ADDRESS_GRANULARITY_BYTE OPTIONAL_CMD GET_COMM_MODE_INFO OPTIONAL_CMD GET_ID OPTIONAL_CMD SET_REQUEST OPTIONAL_CMD SET_MTA OPTIONAL_CMD UPLOAD OPTIONAL_CMD SHORT_UPLOAD OPTIONAL_CMD DOWNLOAD OPTIONAL_CMD SHORT_DOWNLOAD OPTIONAL_CMD GET_CAL_PAGE OPTIONAL_CMD SET_CAL_PAGE OPTIONAL_CMD COPY_CAL_PAGE OPTIONAL_CMD GET_PAG_PROCESSOR_INFO OPTIONAL_CMD GET_SEGMENT_INFO OPTIONAL_CMD GET_PAGE_INFO OPTIONAL_CMD BUILD_CHECKSUM OPTIONAL_CMD USER_CMD OPTIONAL_CMD GET_DAQ_RESOLUTION_INFO OPTIONAL_CMD GET_DAQ_PROCESSOR_INFO OPTIONAL_CMD GET_DAQ_EVENT_INFO OPTIONAL_CMD FREE_DAQ OPTIONAL_CMD ALLOC_DAQ OPTIONAL_CMD ALLOC_ODT OPTIONAL_CMD ALLOC_ODT_ENTRY OPTIONAL_CMD SET_DAQ_PTR OPTIONAL_CMD WRITE_DAQ OPTIONAL_CMD GET_DAQ_LIST_MODE OPTIONAL_CMD SET_DAQ_LIST_MODE OPTIONAL_CMD START_STOP_SYNCH OPTIONAL_CMD START_STOP_DAQ_LIST OPTIONAL_CMD GET_DAQ_CLOCK OPTIONAL_CMD WRITE_DAQ_MULTIPLE OPTIONAL_CMD TIME_CORRELATION_PROPERTIES OPTIONAL_LEVEL1_CMD GET_VERSION /end PROTOCOL_LAYER
 /begin DAQ DYNAMIC 0 2 0 OPTIMISATION_TYPE_DEFAULT ADDRESS_EXTENSION_FREE IDENTIFICATION_FIELD_TYPE_RELATIVE_BYTE GRANULARITY_ODT_ENTRY_SIZE_DAQ_BYTE 0xF8 OVERLOAD_INDICATION_PID /begin TIMESTAMP_SUPPORTED 0x1 SIZE_DWORD UNIT_1NS TIMESTAMP_FIXED /end TIMESTAMP_SUPPORTED
  /begin EVENT "Ecu_10ms" "Ecu_10ms" 0x0 DAQ 0xFF 100 5 0 CONSISTENCY EVENT /end EVENT
  /begin EVENT "Ecu_100ms" "Ecu_100m" 0x1 DAQ 0xFF 100 6 0 CONSISTENCY EVENT /end EVENT
 /end DAQ
/end IF_DATA
/end MODULE
/end PROJECT
